## kernel/Kconfig
```kconfig
mainmenu "kShimC $(VERSION) Configuration"

menu "Architecture"
    source "$srctree/kernel/arch/Kconfig"
endmenu

menu "Drivers"
    source "$srctree/kernel/drivers/Kconfig"
endmenu

source "$srctree/kernel/block/Kconfig"

menu "Qualcomm Input"
    config QCOM_KEYS
        bool "Enable Qualcomm key input"
        default y
        help
            Enable the debounced Qualcomm PON/GPIO key backend.  Volume Up
            maps to menu up, Volume Down maps to menu down, and Power maps to
            menu confirm.

    config QCOM_SPMI
        bool "Enable polled Qualcomm PMIC Arbiter SPMI reader"
        default n
        depends on QCOM_KEYS
        help
            Enable CrDK SPMI and PMIC GPIO input using controllers, bus IDs
            and slave IDs discovered from the runtime device tree.

    config QCOM_KEY_DEBOUNCE_SAMPLES
        int "Key debounce samples"
        range 1 32
        default 2
endmenu

menu "Touch input"
    config KSHIM_TOUCH
        bool "Touch and pointer input service"
        default n
        help
            kshim_input_touch_start()/kshim_input_touch_poll() for the boot
            menu. Controllers come from the touch framework
            (KSHIM_TOUCH_<chip>, docs/io-stack.md, docs/touch.md); with
            none selected it only delivers injected pointer events (USB
            HID).

    source "$srctree/kernel/drivers/input/touch/Kconfig"
endmenu

menu "Multicore"
    config KSHIM_SMP
        bool "Enable PSCI workers"
        default n
    config KSHIM_SMP_SELFTEST
        bool "Run QEMU PSCI self-test and exit"
        depends on KSHIM_SMP
        select KSHIM_LVGL
        default n
    config KSHIM_SMP_WORKERS
        int "Maximum secondary workers"
        depends on KSHIM_SMP
        range 0 7
        default 3
endmenu

menu "Display"
    config KSHIM_QEMU_PLATFORM
        bool "Enable QEMU test memory and framebuffer"
        default y
        help
            Permit virtual test windows. Console resources are always read
            from DT. Disable these test windows for physical boards.

    config KSHIM_FRAMEBUFFER
        bool "Enable validated continuous splash framebuffer UI"
        default y

    config KSHIM_FB_RENDER_ADDRESS
        depends on KSHIM_QEMU_PLATFORM
        hex "Framebuffer render address"
        default 0x0
        help
            Virtual test surface only. Physical platforms discover the live
            scanout layout from SDE and its DT reserved-memory region.

    config KSHIM_FB_WIDTH
        depends on KSHIM_QEMU_PLATFORM
        int "Framebuffer width"
        range 64 4096
        default 128

    config KSHIM_FB_HEIGHT
        depends on KSHIM_QEMU_PLATFORM
        int "Framebuffer height"
        range 48 4096
        default 64

    config KSHIM_FB_STRIDE
        depends on KSHIM_QEMU_PLATFORM
        int "Framebuffer stride in bytes"
        range 0 2147483647
        default 0
        help
            Zero selects the minimum stride for the selected pixel format.

    config KSHIM_FB_FORMAT
        depends on KSHIM_QEMU_PLATFORM
        int "Framebuffer format (1=mono LSB, 2=mono MSB, 3=gray8, 4=RGB565, 5/6=32-bit)"
        range 1 6
        default 1
        help
            LVGL renders color pixels and converts them to this target format.

    config KSHIM_UI_SCRATCH_BASE
        hex "UI scratch memory base (fallback)"
        default 0x0
        depends on KSHIM_LVGL

    config KSHIM_UI_SCRATCH_SIZE
        hex "UI scratch memory size (fallback)"
        default 0x0
        depends on KSHIM_LVGL
        help
            RAM outside the runtime slot for the inflated Noto Sans CJK font
            (about 840 KiB) and, for FLAT only, two background textures.
            Qualcomm boards use the display reservation past scanout.
            Without scratch the menu uses the existing Latin fallback font.

endmenu

menu "Generic"
    config KSHIM_RUNTIME_SLOT_SIZE
        hex "Runtime image slot size"
        default 0x400000
        help
            Bytes reserved for the kShimC runtime, including its stack. The
            image header advertises this size and MultiBootKernelPatcher
            takes the runtime size from the image, so a larger slot needs no
            packer change. 4 MiB fits the minimal profiles; boards with the
            full I/O stack use 8 MiB. A -DKSHIM_RUNTIME_SLOT_SIZE= CMake
            override (tools/build_hdk.py) still wins.

    config KSHIM_BOOT_TRACE
        bool "Print boot stage timings"
        default n
        help
            Print the milliseconds since kshim_main entry after each early
            boot stage (MMU, device tree, console, resources, interrupts).
            For bring-up and test images.

    config KSHIM_UEFI_TEST_MENU
        bool "Two entries that both launch the embedded UEFI FD"
        default n
        help
            Requires KSHIM_UEFI_PAYLOAD in CMake. The two names select the
            same payload, copied into its board-specific FD reservation.

    config KSHIM_UEFI_LOAD_ADDRESS
        hex "UEFI FD destination/entry address"
        default 0xFFC00000
        depends on KSHIM_UEFI_TEST_MENU
    config KSHIM_UEFI_MAX_SIZE
        hex "UEFI FD reserved size"
        default 0x400000
        depends on KSHIM_UEFI_TEST_MENU

    config ENABLE_BANNER
        bool "Enable Boot Banner"
        default y
        help
            Enable or disable the boot banner.
            If disabled, no banner will be displayed during boot.
    config BANNER
        string "Boot Banner"
        default "kShimC v$(VERSION) $(HOST_INFO) $(BUILD_TIME) \n"
        depends on ENABLE_BANNER

    choice
        bool
        prompt "Debug Level"
        default DEBUG_LEVEL_VERBOSE
        config DEBUG_LEVEL_NONE
            bool "None"
        config DEBUG_LEVEL_ERROR
            bool "Error"
        config DEBUG_LEVEL_WARNING
            bool "Warning"
        config DEBUG_LEVEL_INFO
            bool "Info"
        config DEBUG_LEVEL_VERBOSE
            bool "Verbose"
    endchoice

    config ASSERT_HALT
        bool "Halt on Assert Failure"
        default y
endmenu
```

## kernel/arch/arm64/Kconfig
```kconfig
choice
    prompt "MMU Page Size"
    default ARM64_PAGE_SIZE_4K
    help
        Select the page size for the ARM64 MMU. The default is 4KiB.
    depends on CONFIG_ARCH_AARCH64

    config ARM64_PAGE_SIZE_4K
        bool "4KiB"

    config ARM64_PAGE_SIZE_16K
        bool "16KiB"

    config ARM64_PAGE_SIZE_64K
        bool "64KiB"
endchoice
config KSHIM_IRQ
    bool "Interrupt-driven runtime (GICv3 and generic timer)"
    default y
    help
        Discover the GICv3 and the generic timer from the runtime device
        tree, take device and timer interrupts on the boot CPU, and sleep in
        WFI instead of busy-waiting. Interrupt state is restored before
        payload handoff. See docs/interrupts.md. Without it, or when the
        GIC cannot be brought up, the runtime polls as before.

config KSHIM_IRQ_SELFTEST
    bool "Run the QEMU interrupt self-test and exit"
    depends on KSHIM_IRQ && KSHIM_QEMU_PLATFORM && KSHIM_SMP
    default n
    help
        Seed a non-trivial inherited GIC state, then check timer interrupts
        and WFI idle, SGI wake-up of the PSCI workers, the PL011 receive
        interrupt, and that the GIC, CPU interface and timer state after the
        handoff teardown equals the state before kShimC touched it. Used by
        tools/test_qemu_irq.py.
```

## kernel/block/Kconfig
```kconfig
# SPDX-License-Identifier: MIT
menu "Storage and firmware loading"

config BLOCK
    bool "Block device layer and GPT partitions"
    default n
    help
        Block device registry used by storage drivers (UFS, SDHCI), with
        bounds-checked reads split by each device's transfer limit,
        byte-granular reads through a bounce buffer, a RAM-backed device and
        a read-only GPT scanner that registers one partition device per
        entry ("<disk>:<label>").  MIT; no CrDK code.

config FS_FAT
    bool "FAT12/16/32 reader"
    depends on BLOCK
    default n
    help
        Read-only FAT reader from CrDK FirmwareLoaderLib (MIT).  Typical use:
        the NON-HLOS "modem" partition.

config FS_EXT4
    bool "ext4 reader"
    depends on BLOCK
    default n
    help
        Read-only ext4 reader from CrDK FirmwareLoaderLib (MIT): extents,
        indirect blocks and metadata checksums on a clean filesystem; no
        journal replay, encryption, inline data or bigalloc.

config FS_F2FS
    bool "F2FS reader"
    depends on BLOCK
    default n
    help
        Read-only F2FS reader from CrDK FirmwareLoaderLib (MIT).  Requires a
        clean checkpoint; encrypted, compressed and casefolded files are
        refused.

config FS_EROFS
    bool "EROFS reader (makes the resulting binary GPL-2.0)"
    depends on BLOCK
    default n
    help
        Read-only EROFS reader from CrDK FirmwareLoaderLib NhErofs.c, which
        is licensed GPL-2.0-or-later (it carries a U-Boot derived compact
        index decoder).  kShimC itself is MIT.  Enabling this option links
        GPL-2.0-or-later code into kShimC, so the resulting binary as a whole
        must be distributed under the terms of the GPL, version 2 or later,
        including the corresponding source.  Leave it disabled for an
        MIT-only binary.

config FS_CORE
    bool
    default y if FS_FAT || FS_EXT4 || FS_F2FS || FS_EROFS
    help
        Filesystem adapter (kernel/fs) and Android liblp "super" reader over CrDK
        FirmwareLoaderLib; selected by any filesystem reader.

config FIRMWARE_LOADER
    bool "Android firmware loader"
    depends on BLOCK && FS_CORE
    default n
    help
        Loads firmware from the Android partitions of the internal storage
        device using CrDK FirmwareLoaderLib's selection policy: ordered
        explicit locations (super/vendor{slot}, modem{slot}, ...), current
        boot slot from the bootloader handoff, Virtual A/B admission and
        PIL .mdt/.bXX group consistency.  See docs/firmware-loader.md.

endmenu
```

## kernel/drivers/Kconfig
```kconfig
config KSHIM_CONSOLE_USB_ACM
    bool "Mirror the console to a USB CDC-ACM device (DWC3)"
    default n
    help
        Run the DWC3 controller found in the runtime DT ("qcom,dwc3" or
        "qcom,dwc-usb3-msm" with an "snps,dwc3" child) as a USB serial
        device using CrDK's UsbAcmCrLib, and mirror the DT-selected UART
        console to it. Input is accepted from both. Output written before
        a host opens the port is kept (16 KiB) and sent once it reads.

        The previous bootloader must leave USB powered and clocked; no
        clock, GDSC, PHY or reset is touched, and an unclocked controller
        can hang the bus. The controller is polled from console writes,
        input polling and idle delays, and stopped before payload handoff.

source "$srctree/kernel/drivers/block/Kconfig"
source "$srctree/kernel/drivers/irqchip/Kconfig"

# I/O stack (docs/io-stack.md). One fragment per owner; all symbols default n.
menu "I/O stack"
source "$srctree/kernel/drivers/gpio/Kconfig"
source "$srctree/kernel/drivers/regulator/Kconfig"
source "$srctree/kernel/drivers/qup/Kconfig"
source "$srctree/kernel/drivers/pci/Kconfig"
source "$srctree/kernel/drivers/usb/Kconfig"
source "$srctree/kernel/drivers/usb/class/Kconfig"
endmenu
```

## kernel/drivers/block/Kconfig
```kconfig
# SPDX-License-Identifier: MIT
menu "Block storage"
    config BLK_UFS
        bool "Qualcomm UFS (UFSHCI) logical units as block devices"
        default n
        depends on BLOCK
        help
            Discover the "qcom,ufshc" host from DT and register one block
            device per enabled logical unit ("ufs0:lu<N>"). The controller
            and link left running by XBL/ABL are taken over when verifiably
            live. Rails, GDSC and clocks use CrDK target data and ClockLib
            (SM8250); the QMP PHY is never calibrated by kShimC.

    config BLK_UFS_FULL_INIT
        bool "Fall back to a UFSHCI reset and link startup"
        default y
        depends on BLK_UFS
        help
            When the inherited controller state is not live, reset the host
            controller and redo DME_LINKSTARTUP and fDeviceInit on the
            still-powered PHY. When disabled, only an inherited live
            controller is used and it is never reset.

    config BLK_UFS_WRITE
        bool "Expose UFS writes (SCSI WRITE(10/16))"
        default n
        depends on BLK_UFS

    config BLK_QCOM_CLOCKS
        bool "Drive storage GDSC/clocks with CrDK ClockLib (SM8250 graph)"
        default n
        depends on BLK_UFS || BLK_SDHCI
        help
            Links CrDK ClockLib and the SM8250 GCC target graph (about
            80 KiB) so the UFS GDSC/clocks and the SDCC AHB/APPS clocks can
            be acquired and the SD card clock rate changed. Without it, UFS
            is used only when its GDSC is already powered (inherited power
            and clocks), and SDHCI cannot run.

    config BLK_SDHCI
        bool "Qualcomm SDCC (sdhci-msm v5) SD/eMMC as block devices"
        default n
        depends on BLOCK
        select BLK_QCOM_CLOCKS
        help
            Identify an SD card or eMMC behind a "qcom,sdhci-msm-v5" host
            using CrDK's SdhciMsmLib PIO core and register "sdhc<N>".
            Needs a CrDK SD target and clock graph for the SoC (SM8250).

    config BLK_SDHCI_WRITE
        bool "Expose SD/eMMC writes (CMD24/CMD25)"
        default n
        depends on BLK_SDHCI
endmenu
```

## kernel/drivers/input/touch/Kconfig
```kconfig
# SPDX-License-Identifier: MIT
# Owner: touch-st (docs/io-stack.md). Goodix drivers: Kconfig.goodix
# (touch-goodix).

config KSHIM_TOUCH_FRAMEWORK
    def_bool KSHIM_TOUCH_FTM4 || KSHIM_TOUCH_FTM5 || KSHIM_TOUCH_GT911 || KSHIM_TOUCH_GT9916
    help
        Touch controller framework (kshim/touch_driver.h). Without it,
        KSHIM_TOUCH only carries injected pointer events (USB HID).

config KSHIM_TOUCH_FTM5
    bool "ST FingerTip FTM5 (I2C)"
    depends on KSHIM_TOUCH && KSHIM_I2C && KSHIM_REGULATOR
    default n
    help
        Android "st,fts" nodes with the fts,* property family (Xiaomi Mi MIX
        3 5G "andromeda"): the kernel/drivers/st_ftm5.c protocol core on the
        touch framework. Needs the GENI I2C controller (KSHIM_QUP) on
        Qualcomm boards.

config KSHIM_TOUCH_FTM4
    bool "ST FingerTip FTM4 (I2C)"
    depends on KSHIM_TOUCH && KSHIM_I2C && KSHIM_REGULATOR
    default n
    help
        Android "st,fts" nodes with the st,* property family (Qualcomm
        SM8250 HDK/QRD): sense on/off, controller-ready wait, chip ID 36 70
        and the 8-byte pointer events, written from protocol facts
        (configs/hdk8250-touch-provenance.json).

source "$srctree/kernel/drivers/input/touch/Kconfig.goodix"
```
