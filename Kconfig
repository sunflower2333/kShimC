## kernel/drivers/input/touch/Kconfig.goodix
```kconfig
# SPDX-License-Identifier: MIT
# Owner: touch-goodix (docs/io-stack.md, docs/touch-goodix.md).

config KSHIM_TOUCH_GT911
    bool "Goodix GT911 (I2C)"
    depends on KSHIM_TOUCH && KSHIM_I2C && KSHIM_REGULATOR
    default n
    help
        Goodix GT911 on I2C ("goodix,gt911", reg 0x5d or 0x14), for
        example the AYANEO Pocket S2 touchscreen on &i2c4. Selects the
        DT address with the INT level at the reset release, reads the
        product ID and configuration (0x8140, 0x8047) and reports the
        points at 0x814E/0x814F. A controller the previous bootloader left
        running is inherited without a reset. Interrupt-driven through
        the TLMM with a polling fallback.

config KSHIM_TOUCH_GT9916
    bool "Goodix GT9916 Berlin (SPI)"
    depends on KSHIM_TOUCH && KSHIM_SPI && KSHIM_REGULATOR
    default n
    help
        Goodix GT9916 ("goodix,gt9916", Berlin-D protocol) on SPI, for
        example the Qualcomm QRD8650 touchscreen on &spi4. Boot-option
        handshake, firmware version and IC information (touch data
        address) reads, checksummed touch events. Requires
        touchscreen-size-x/y in the DT. Interrupt-driven through the TLMM
        with a polling fallback.
```

## kernel/drivers/irqchip/Kconfig
```kconfig
# Qualcomm interrupt cascades and interrupt-driven drivers
# (docs/interrupts.md layers 2 and 3). Everything here needs the GICv3 core.
config QCOM_IRQCHIP
    bool "Qualcomm TLMM, PDC and SPMI interrupt cascades"
    depends on KSHIM_IRQ
    default y
    help
        TLMM summary dispatch of per-GPIO interrupts, PDC routes for the
        GIC SPIs the PDC feeds, and SPMI PMIC arbiter (periph_irq) dispatch
        through CrDK SpmiSharedCrLib. Every pin, PDC field and PMIC bit is
        saved before use and restored before payload handoff.

config KSHIM_INPUT_IRQ
    bool "Interrupt-driven keys and touch"
    depends on QCOM_IRQCHIP && (QCOM_KEYS || KSHIM_TOUCH)
    default y
    help
        PMIC PON and PMIC-GPIO keys through the SPMI cascade, TLMM
        gpio-keys and the touch controller IRQ GPIO through the TLMM
        cascade. Events are queued by the handlers; a key or controller
        whose interrupt does not resolve keeps polling.

config KSHIM_CONSOLE_RX_IRQ
    bool "Interrupt-driven GENI console RX"
    depends on QCOM_IRQCHIP
    default y
    help
        Queue received bytes from the QUP serial engine's RX FIFO
        watermark/last interrupt. TX keeps DebugUartLib's polled path.
```

## kernel/drivers/pci/Kconfig
```kconfig
# SPDX-License-Identifier: MIT
# Owner: pci (docs/io-stack.md).

config KSHIM_PCI
    bool "PCI core"
    default n
    help
        PCI host-bridge registry, config access, bus enumeration, BAR
        assignment from DT "ranges" (inherited assignments are kept),
        INTx resolution through "interrupt-map" (MSI where the host offers
        it), a vendor/device/class driver registry and a config-write journal
        replayed before payload handoff.

config KSHIM_PCI_ECAM
    bool "Generic ECAM host bridge (pci-host-ecam-generic, QEMU virt)"
    depends on KSHIM_PCI
    default n

config KSHIM_PCI_QCOM
    bool "Qualcomm PCIe root complex"
    depends on KSHIM_PCI && KSHIM_REGULATOR
    select KSHIM_GPIO
    select KSHIM_CLK
    default n
    help
        DesignWare-based Qualcomm root complexes. A link the previous
        bootloader left up is inherited (only an iATU config window is
        owned and restored); otherwise the port is cold-initialised with
        CrDK PcieLib and per-SoC target data, and shut down again before
        handoff.

config KSHIM_PCI_SELFTEST
    bool "PCI enumeration self-test (QEMU)"
    depends on KSHIM_PCI
    default n
    help
        Probe-only driver for xHCI functions used by tools/test_qemu_pci.py:
        enables memory decoding, reads the xHCI capability registers through
        BAR0, requests and frees the interrupt, and logs PCI_SELFTEST lines.
        The function is left unbound and every change is undone at handoff.
```

## kernel/drivers/qup/Kconfig
```kconfig
# SPDX-License-Identifier: MIT
# Owner: qup (docs/io-stack.md).

config KSHIM_QUP
    bool "Qualcomm QUPv3/GENI serial engines"
    default n
    select KSHIM_GPIO
    select KSHIM_CLK
    help
        Discover QUPv3 wrappers and GENI serial engines from the runtime DT
        (mainline and Android bindings), arbitrate serial-engine ownership
        (console, I2C, SPI, UART) and bring up engine clocks and pins when the
        boot chain left them off. SE firmware is never loaded: the protocol
        already loaded must match. Everything is restored before handoff.

config KSHIM_I2C
    bool "I2C bus"
    default n
    help
        I2C core with DT child enumeration and multi-message transfers with
        repeated START (kshim/i2c.h). With KSHIM_QUP, GENI I2C controllers are
        probed on demand; completion is interrupt-driven with a polling
        fallback.

config KSHIM_I2C_GENI
    def_bool KSHIM_I2C && KSHIM_QUP

config KSHIM_SPI
    bool "SPI bus"
    default n
    help
        SPI core with DT child enumeration (chip select, mode, maximum
        frequency) and full-duplex transfers (kshim/spi.h). With KSHIM_QUP,
        GENI SPI controllers are probed on demand.

config KSHIM_SPI_GENI
    def_bool KSHIM_SPI && KSHIM_QUP
```

## kernel/drivers/regulator/Kconfig
```kconfig
# SPDX-License-Identifier: MIT
# Owner: sm8650 (docs/io-stack.md).

config KSHIM_REGULATOR
    bool "Regulators from DT supplies (fixed GPIO and RPMh)"
    default n
    select KSHIM_GPIO
    help
        Resolve "<name>-supply" phandles to regulator-fixed rails with a GPIO
        enable and to RPMh VRM/XOB rails (CrDK CmdDBLib and RpmhLib polling
        API), with enable/disable reference counting. Fixed rails return to
        their inherited GPIO level before payload handoff; RPMh votes follow
        the policy in kshim/regulator.h.
```

## kernel/drivers/usb/Kconfig
```kconfig
# SPDX-License-Identifier: MIT
# Owner: xhci (docs/io-stack.md). Class drivers: usb/class/Kconfig (usbhid).

config KSHIM_USB
    bool "USB host core"
    default n
    help
        USB device model, enumeration, control/bulk/interrupt transfers with
        completion callbacks and a class-driver registry (kshim/usb.h,
        kshim/usb_hcd.h). Host controllers are stopped and reset before
        payload handoff.

config KSHIM_DMA_POOL_SIZE
    hex "DMA pool size for bus-master devices"
    depends on KSHIM_USB
    default 0x40000
    help
        Static, page-aligned pool in the runtime image (kshim/dma.h) for the
        xHCI rings, device contexts, scratchpads, transfer bounce buffers
        and the Renesas firmware image while it is downloaded. About 8 KiB
        per enumerated device plus the controller's scratchpad pages.

config KSHIM_USB_XHCI
    bool "xHCI host controllers on PCI"
    depends on KSHIM_USB && KSHIM_PCI
    default n
    help
        xHCI 1.x driver for PCI class 0x0c0330 functions (QEMU qemu-xhci and
        nec-usb-xhci, Renesas uPD720201/uPD720202). Interrupt-driven through
        the PCI core (INTx/MSI) with event-ring polling as the fallback.
        A controller left running by the previous firmware is taken over
        after a clean halt and reset.

config KSHIM_USB_XHCI_FORCE_POLL
    bool "Poll the xHCI event ring instead of using its interrupt"
    depends on KSHIM_USB_XHCI
    default n
    help
        Bring-up and test aid: never request the PCI interrupt, so every
        event is found by the polling fallback.

config KSHIM_USB_XHCI_RENESAS
    bool "Renesas uPD720201/uPD720202 firmware download"
    depends on KSHIM_USB_XHCI
    default n
    help
        Download the controller firmware unless an external ROM is present
        or the firmware already runs. The image is read with the Android
        firmware loader (CONFIG_FIRMWARE_LOADER); without the loader only
        the ROM and already-running cases work.

config KSHIM_USB_XHCI_RENESAS_FW
    string "Renesas firmware file name"
    depends on KSHIM_USB_XHCI_RENESAS
    default "renesas_usb_fw.mem"

config KSHIM_USB_XHCI_RENESAS_FW_EMBED
    string "Optional Renesas firmware image to link into the runtime"
    depends on KSHIM_USB_XHCI_RENESAS
    default ""
    help
        Path, at build time, of a firmware image to embed. Empty (the
        default) embeds nothing. When set, the embedded image is used
        whenever the controller needs firmware (after "already running" and
        the external ROM) and no partition is read. The image is Renesas'
        proprietary firmware: never commit it, and do not redistribute a
        runtime that embeds it unless Renesas' terms allow it.

config KSHIM_USB_SELFTEST
    bool "USB core self-test class driver (QEMU test)"
    depends on KSHIM_USB
    default n
    help
        Binds HID interfaces, fetches their report descriptor, submits an
        interrupt-IN URB and logs reports; kshim_usb_settle() then waits up
        to KSHIM_USB_SELFTEST_MS for two reports. Test builds only.

config KSHIM_USB_SELFTEST_MS
    int "Self-test report wait (ms)"
    depends on KSHIM_USB_SELFTEST
    default 5000
```

## kernel/drivers/usb/class/Kconfig
```kconfig
# SPDX-License-Identifier: MIT
# Owner: usbhid (docs/io-stack.md).

config KSHIM_INPUT_INJECT
    bool
    help
        Kernel input injection (kshim/input_inject.h): injected menu keys
        and pointer events reach kshim_key_source_poll() and
        kshim_input_touch_poll() consumers.

config KSHIM_USB_HUB
    bool "USB hub class driver"
    depends on KSHIM_USB
    default n
    help
        USB 2.0 and SuperSpeed hubs, nested up to tier 6: port power,
        debounce, reset, enumeration and removal of the devices below.
        Port changes come from the hub's status-change endpoint; a hub
        whose endpoint keeps failing is polled instead.

config KSHIM_USB_HID
    bool "USB HID keyboards, mice, tablets and gamepads as menu input"
    depends on KSHIM_USB
    select KSHIM_INPUT_INJECT
    default n
    help
        Map HID keyboards (arrows, Enter, Escape), gamepads and joysticks
        (hat/D-pad, stick, buttons), consumer volume keys, mice and tablets
        to the boot menu's UP/DOWN/SELECT/BACK actions and pointer. Pointer
        events are delivered through the touch service (KSHIM_TOUCH).
        XInput-class gamepads (interface 0xff/0x5d/0x01, Xbox 360-style)
        are mapped as gamepads too, as a fallback for controllers without
        a HID report descriptor.
```

## src/Kconfig
```kconfig
mainmenu "kShimC $(VERSION) Configuration"

menu "Architecture"
    source "$srctree/arch/Kconfig"
endmenu

menu "Drivers"
    source "$srctree/drivers/Kconfig"
endmenu

menu "Generic"
    config ENABLE_BANNER
        bool "Enable Boot Banner"
        default y
        help
            Enable or disable the boot banner.
            If disabled, no banner will be displayed during boot.

    config BANNER
        string "Boot Banner"
        # prompt "Boot Banner"
        default "kShimC v$(VERSION) $(HOST_INFO) $(BUILD_TIME) \n"
        help 
            A banner message displayed during boot.
        depends on ENABLE_BANNER

    choice
        bool
        prompt "Debug Level"
        default DEBUG_LEVEL_VERBOSE

        config DEBUG_LEVEL_NONE
            bool "None"
            help
                No debug messages will be printed.

        config DEBUG_LEVEL_ERROR
            bool "Error"
            help
                Only error messages will be printed.

        config DEBUG_LEVEL_WARNING
            bool "Warning"
            help
                Warning and error messages will be printed.

        config DEBUG_LEVEL_INFO
            bool "Info"
            help
                Info, warning, and error messages will be printed.

        config DEBUG_LEVEL_VERBOSE
            bool "Verbose"
            help
                All debug messages will be printed, including verbose messages.
    endchoice

    config ASSERT_HALT
        bool "Halt on Assert Failure"
        default y
endmenu
```

## src/arch/arm64/Kconfig
```kconfig
choice
    prompt "MMU Page Size"
    default CONFIG_PAGE_SIZE_4K
    help
        Select the page size for the MMU. The default is 4KiB.
    depends on CONFIG_ARCH_AARCH64

    config CONFIG_PAGE_SIZE_4K
        bool "4KiB"

    config CONFIG_PAGE_SIZE_16K
        bool "16KiB"

    config CONFIG_PAGE_SIZE_64K
        bool "64KiB"
endchoice
```

## src/ui/styles/Kconfig
```kconfig
# 十个现代视觉预设，全部属于外层 KSHIM_MENU_STYLE choice。
config KSHIM_MENU_STYLE_FLUENT
    bool "FLUENT - Fluent 2 inspired light surfaces"
    help
        Neutral layered surfaces, fine accent rail and compact rounded controls.
        Software-rendered approximation; does not call Windows Mica APIs.
config KSHIM_MENU_STYLE_MATERIAL3
    bool "MATERIAL3 - tonal containers and pill action"
    help
        Material 3 inspired light roles, tonal selection, generous corner
        radii and a filled pill Boot button. No Material 2 or native theme.
config KSHIM_MENU_STYLE_SURFACE
    bool "SURFACE - Microsoft Surface UEFI inspired menu"
    help
        Wide landscape screens separate boot navigation and selected-image
        information. Narrow screens retain a single column. No fake UEFI
        settings, Microsoft branding assets or changed boot semantics.
config KSHIM_MENU_STYLE_CUPERTINO
    bool "CUPERTINO - grouped light list"
    help
        Rounded outer group, fine row separators and a blue primary action.
config KSHIM_MENU_STYLE_GLASS
    bool "GLASS - translucent blue glass-like panel"
    help
        Translucency, gradient and a fine rim over a static gradient background.
        This is glass-like composition, not live backdrop blur.
config KSHIM_MENU_STYLE_AURORA
    bool "AURORA - teal and violet gradients"
    help
        Dark layered surfaces, tonal gradient selection and a mint pill action.
config KSHIM_MENU_STYLE_SOFT_UI
    bool "SOFT_UI - soft raised surfaces"
    help
        Light rims, small bounded shadows and a depressed pressed state.
        A visible focus outline remains independent of the shadows.
config KSHIM_MENU_STYLE_BENTO
    bool "BENTO - adaptive numbered cards"
    help
        Two columns on sufficiently wide panels, one column on narrow panels.
        Numbered cards retain row-major physical-key navigation and Boot-only
        touch confirmation.
config KSHIM_MENU_STYLE_NEON
    bool "NEON - restrained cyan focus glow"
    help
        Dark surfaces with a bounded focus glow and cyan primary action.
        No scanlines, retro styling or continuous decorative animation.
config KSHIM_MENU_STYLE_NORD
    bool "NORD - calm slate surfaces"
    help
        Cool slate surfaces, clear cyan focus rail and restrained motion.
```
