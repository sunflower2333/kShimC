## user/Kconfig
```kconfig
# Userspace: the boot menu application (see docs/source-layout.md).
menu "Boot menu UI"
    config KSHIM_LVGL
        bool "Enable LVGL boot menu"
        default y
        help
            Build the pinned LVGL boot menu with a selectable visual style.
            The default FLAT style retains the animated acrylic panel.
            Qualcomm Volume Up, Volume Down, and Power map to up, down,
            and confirm respectively. See docs/menu-styles.md.

    choice KSHIM_MENU_STYLE
        prompt "Boot menu style"
        depends on KSHIM_LVGL
        default KSHIM_MENU_STYLE_FLAT
        help
            Select the device boot menu appearance, not host menuconfig colors.
            Input and boot actions are shared. Only FLAT uses animated textures.
            Modern styles do not enable LVGL's built-in default theme.

        config KSHIM_MENU_STYLE_FLAT
            bool "FLAT - original dark acrylic"
        config KSHIM_MENU_STYLE_CLASSIC
            bool "CLASSIC - existing framed firmware menu"
        config KSHIM_MENU_STYLE_CARDS
            bool "CARDS - existing light rounded cards"
        config KSHIM_MENU_STYLE_TERMINAL
            bool "TERMINAL - existing green terminal look"
        config KSHIM_MENU_STYLE_MINIMAL
            bool "MINIMAL - existing quiet monochrome"
        config KSHIM_MENU_STYLE_HIGH_CONTRAST
            bool "HIGH_CONTRAST - existing black and white"

        source "$srctree/user/ui/styles/Kconfig"
    endchoice

    config KSHIM_LVGL_BUFFER_BYTES
        int "LVGL partial render buffer size"
        range 128 1048576
        default 16384
        depends on KSHIM_LVGL
        help
            Bytes per partial color render buffer. Must hold one framebuffer
            row. Board profiles use 256 KiB buffers.

    config KSHIM_MENU_ENTRY1
        string "First menu entry"
        default "Boot"
    config KSHIM_MENU_ENTRY2
        string "Second menu entry"
        default "Recovery"
endmenu

source "$srctree/user/ui/menu_design.Kconfig"
```
